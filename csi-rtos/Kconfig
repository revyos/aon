## csi-rtos/validations/core/Kconfig
```kconfig
choice
       prompt "select"
       help
         select the core validation

config BUILD_VAL_CACHE
       bool "test core cache"
       help
          select the core cache test

if BUILD_VAL_CACHE
source "validations/core/cache/Kconfig"
endif

config BUILD_VAL_CALCULATION
       bool "test core calculation"
       help
          select the core calculation test

if BUILD_VAL_CALCULATION
source "validations/core/calculation/Kconfig"
endif

config BUILD_VAL_MMU
       bool "test core mmu"
       help
          select the core mmu test

if BUILD_VAL_MMU
source "validations/core/mmu/Kconfig"
endif

config BUILD_VAL_MPU
       bool "test core mpu"
       help
          select the core mpu test

if BUILD_VAL_MPU
source "validations/core/mpu/Kconfig"
endif

config BUILD_VAL_VIC
       bool "test core vic"
       help
          select the core vic test

if BUILD_VAL_VIC
source "validations/core/vic/Kconfig"
endif

endchoice
```

## csi-rtos/validations/core/cache/Kconfig
```kconfig
choice
       prompt "select"
       depends on BUILD_VAL_CACHE
       default BUILD_VAL_CACHE_PROFILE
       help
         select the test module

config BUILD_VAL_DCACHE_BASIC
       bool "build validation dcache basic"
       depends on BUILD_VAL_CACHE
       help
         select the dcache basic test

config BUILD_VAL_CACHE_PROFILE
       bool "build validation cache profile"
       depends on BUILD_VAL_CACHE
       help
         select the cache profile test

endchoice
```

## csi-rtos/validations/core/calculation/Kconfig
```kconfig
choice
       prompt "select"
       depends on BUILD_VAL_CALCULATION
       default BUILD_VAL_CALCULATION01
       help
         select the test module

config BUILD_VAL_CALCULATION01
       bool "build validation calculation01"
       depends on BUILD_VAL_CALCULATION
       help
         select the calculation test

endchoice
```

## csi-rtos/validations/core/mmu/Kconfig
```kconfig
choice
       prompt "select"
       depends on BUILD_VAL_MMU
       default BUILD_VAL_MMU01
       help
         select the test module

config BUILD_VAL_MMU01
       bool "build validation mmu01"
       depends on BUILD_VAL_MMU
       help
         select the mmu test

config BUILD_VAL_MMU01_CK610M
       bool "build validation mmu01_ck610m"
       depends on BUILD_VAL_MMU
       help
         select the mmu01 ck610m test

endchoice
```

## csi-rtos/validations/core/mpu/Kconfig
```kconfig
choice
       prompt "select"
       depends on BUILD_VAL_MPU
       default BUILD_VAL_MPU01
       help
         select the test module

config BUILD_VAL_MPU01
       bool "build validation mpu01"
       depends on BUILD_VAL_MPU
       help
         select the mpu test

config BUILD_VAL_MPU01_CK610
       bool "build validation mpu01_ck610"
       depends on BUILD_VAL_MPU
       help
         select the mpu01 ck610 test

endchoice
```

## csi-rtos/validations/core/vic/Kconfig
```kconfig
choice
       prompt "select"
       depends on BUILD_VAL_VIC
       default BUILD_VAL_VIC01
       help
         select the test module

config BUILD_VAL_VIC01
       bool "build validation vic01"
       depends on BUILD_VAL_VIC
       help
         select the vic test

endchoice
```

## csi-rtos/validations/driver/Kconfig
```kconfig
choice
         prompt "select"
         help
           select the driver validation

config BUILD_VAL_AES
       bool "build validation aes"
       depends on BUILD_VAL_DRIVER
       help
         select the aes driver validation

if BUILD_VAL_AES
source "validations/driver/aes/Kconfig"
endif

config BUILD_VAL_DMAC
       bool "build validation dmac"
       help
         select the dmac driver validation

if BUILD_VAL_DMAC
source "validations/driver/dmac/Kconfig"
endif

config BUILD_VAL_GPIO
       bool "build validation gpio"
       help
         select the gpio driver validation

if BUILD_VAL_GPIO
source "validations/driver/gpio/Kconfig"
endif

config BUILD_VAL_IIC
       bool "build validation iic"
       help
         select the iic driver validation

if BUILD_VAL_IIC
source "validations/driver/iic/Kconfig"
endif

config BUILD_VAL_SPU_IIC
       bool "build validation spu iic"
       help
         select the spu iic driver validation

if BUILD_VAL_SPU_IIC
source "validations/driver/spu_iic/Kconfig"
endif

config BUILD_VAL_USI_IIC
       bool "build validation usi iic"
       help
         select the usi iic driver validation

if BUILD_VAL_USI_IIC
source "validations/driver/usi_iic/Kconfig"
endif

config BUILD_VAL_SHA
       bool "build validation sha"
       help
         select the sha driver validation

if BUILD_VAL_SHA
source "validations/driver/sha/Kconfig"
endif

config BUILD_VAL_RSA
       bool "build validation rsa"
       help
         select the rsa driver validation

if BUILD_VAL_RSA
source "validations/driver/rsa/Kconfig"
endif

config BUILD_VAL_TIMER
       bool "build validation timer"
       help
         select the timer driver validation

if BUILD_VAL_TIMER
source "validations/driver/timer/Kconfig"
endif

config BUILD_VAL_USART
       bool "build validation usart"
       help
         select the uart driver validation

if BUILD_VAL_USART
source "validations/driver/usart/Kconfig"
endif

config BUILD_VAL_SPU_USART
       bool "build validation spu usart"
       help
         select the uart driver validation

if BUILD_VAL_SPU_USART
source "validations/driver/spu_usart/Kconfig"
endif

config BUILD_VAL_USI_USART
       bool "build validation usi usart"
       help
         select the uart driver validation

if BUILD_VAL_USI_USART
source "validations/driver/usi_usart/Kconfig"
endif

config BUILD_VAL_TRNG
       bool "build validation trng"
       help
         select the trng driver validation

if BUILD_VAL_TRNG
source "validations/driver/trng/Kconfig"
endif

config BUILD_VAL_CRC
       bool "build validation crc"
       help
         select the crc driver validation

if BUILD_VAL_CRC
source "validations/driver/crc/Kconfig"
endif

config BUILD_VAL_EFLASH
       bool "build validation eflash"
       help
         select the eflash driver validation

if BUILD_VAL_EFLASH
source "validations/driver/eflash/Kconfig"
endif

config BUILD_VAL_SPIFLASH
       bool "build validation spiflash"
       help
         select the eflash driver validation

if BUILD_VAL_SPIFLASH
source "validations/driver/spiflash/Kconfig"
endif

config BUILD_VAL_SPI
       bool "build validation spi"
       help
         select the spi driver validation

if BUILD_VAL_SPI
source "validations/driver/spi/Kconfig"
endif

config BUILD_VAL_SPU_SPI
       bool "build validation spu spi"
       help
         select the spu spi driver validation

if BUILD_VAL_SPU_SPI
source "validations/driver/spu_spi/Kconfig"
endif

config BUILD_VAL_USI_SPI
       bool "build validation usi spi"
       help
         select the usi spi driver validation

if BUILD_VAL_USI_SPI
source "validations/driver/usi_spi/Kconfig"
endif

config BUILD_VAL_WDT
       bool "build validation wdt"
       help
         select the wdt driver validation

if BUILD_VAL_WDT
source "validations/driver/wdt/Kconfig"
endif

config BUILD_VAL_RTC
       bool "build validation rtc"
       help
         select the rtc driver validation

if BUILD_VAL_RTC
source "validations/driver/rtc/Kconfig"
endif

config BUILD_VAL_PWM
       bool "build validation pwm"
       help
         select the pwm driver validation

if BUILD_VAL_PWM
source "validations/driver/pwm/Kconfig"
endif

config BUILD_VAL_ETH
       bool "build validation eth"
       help
         select the ethernet driver validation

if BUILD_VAL_ETH
source "validations/driver/eth/Kconfig"
endif

config BUILD_VAL_I2S
       bool "build validation i2s"
       help
         select the ethernet driver validation

if BUILD_VAL_I2S
source "validations/driver/i2s/Kconfig"
endif

endchoice
```

## csi-rtos/validations/driver/aes/Kconfig
```kconfig
choice
       prompt "select"
       depends on BUILD_VAL_AES
       default BUILD_VAL_AES01
       help
         select the test module

config BUILD_VAL_AES01
       bool "build validation aes01"
       depends on BUILD_VAL_AES
       help
         select the aes driver validation

config BUILD_VAL_AES02
       bool "build validation aes02"
       depends on BUILD_VAL_AES
       help
         select the aes driver validation
endchoice
```

## csi-rtos/validations/driver/crc/Kconfig
```kconfig
choice
       prompt "select"
       depends on BUILD_VAL_CRC
       default BUILD_VAL_CRC01
       help
         select the test module

config BUILD_VAL_CRC01
       bool "build validation crc01"
       depends on BUILD_VAL_CRC
       help
         select the crc driver validation

config BUILD_VAL_CRC02
       bool "build validation crc02"
       depends on BUILD_VAL_CRC
       help
         select the crc driver validation
endchoice
```

## csi-rtos/validations/driver/dmac/Kconfig
```kconfig
choice
       prompt "select"
       depends on BUILD_VAL_DMAC
       default BUILD_VAL_DMAC01
       help
         select the test module

config BUILD_VAL_DMAC01
       bool "build validation dmac01"
       depends on BUILD_VAL_DMAC
       help
         select the dmac driver validation

endchoice
```

## csi-rtos/validations/driver/eflash/Kconfig
```kconfig
choice
       prompt "select"
       depends on BUILD_VAL_EFLASH
       default BUILD_VAL_EFLASH01
       help
         select the test module

config BUILD_VAL_EFLASH01
       bool "build validation eflash01"
       depends on BUILD_VAL_EFLASH
       help
         select the eflash driver validation

config BUILD_VAL_EFLASH02
       bool "build validation eflash02"
       depends on BUILD_VAL_EFLASH
       help
         select the eflash driver validation
endchoice
```
