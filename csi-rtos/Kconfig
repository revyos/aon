## csi-rtos/csi/csi/Kconfig
```kconfig
choice
     prompt "arch options"
     default ARCH_CSKY
     help
       select the architecture

config ARCH_CSKY
     bool "csky"
     help
       csky architecture

config ARCH_RV32
     bool "rv32"
     help
       rv32 architecture

config ARCH_RV64
     bool "rv64"
     help
       rv64 architecture

config ARCH_ARM
     bool "arm"
     help
       arm architecture

endchoice

choice
     prompt "cpu options"
     default CPU_E802
     depends on ARCH_CSKY
     help
       select the cpu

config CPU_E801
     bool "e801"
     help
       cpu of e801

config CPU_E802
     bool "e802"
     help
       cpu of e802

config CPU_E802T
     bool "e802t"
     select SYSTEM_SECURE
     help
       cpu of e802t

config CPU_S802
     bool "s802"
     help
       cpu of s802

config CPU_S802T
     bool "s802t"
     select SYSTEM_SECURE
     help
       cpu of s802t

config CPU_E803
     bool "e803"
     help
       cpu of e803

config CPU_E803T
     bool "e803t"
     select SYSTEM_SECURE
     help
       cpu of e803t

config CPU_S803
     bool "s803"
     help
       cpu of s803

config CPU_S803T
     bool "s803t"
     select SYSTEM_SECURE
     help
       cpu of s803t

config CPU_E804D
    bool "e804d"
     help
       cpu of e804d

config CPU_E804DT
    bool "e804dt"
    select SYSTEM_SECURE
    help
      cpu of e804dt

config CPU_E804F
     bool "e804f"
     help
       cpu of e804f

config CPU_E804FT
     bool "e804ft"
     select SYSTEM_SECURE
     help
       cpu of e804ft

config CPU_E804DF
     bool "e804df"
     help
       cpu of e804df

config CPU_E804DFT
     bool "e804dft"
     select SYSTEM_SECURE
     help
       cpu of e804dft

config CPU_I805
     bool "i805"
     help
       cpu of i805

config CPU_I805F
     bool "i805f"
     help
       cpu of i805f

config CPU_CK801
     bool "ck801"
     help
       cpu of ck801

config CPU_CK802
     bool "ck802"
     help
       cpu of ck802

config CPU_CK803
     bool "ck803"
     help
       cpu of ck803

config CPU_CK803T
     bool "ck803t"
     help
       cpu of ck803t

config CPU_CK803F
     bool "ck803f"
     help
       cpu of ck803f

config CPU_CK803ER1
     bool "ck803er1"
     help
       cpu of ck803er1

config CPU_CK803EFR1
     bool "ck803efr1"
     help
       cpu of ck803efr1

config CPU_CK803EFR2
     bool "ck803efr2"
     help
       cpu of ck803efr2

config CPU_CK803EFR3
     bool "ck803efr3"
     help
       cpu of ck803efr3

config CPU_CK803EF
     bool "ck803ef"
     help
       cpu of ck803ef

config CPU_CK804EF
     bool "ck804ef"
     help
       cpu of ck804ef

config CPU_CK805
     bool "ck805"
     help
       cpu of ck805

config CPU_CK805E
     bool "ck805e"
     help
       cpu of ck805e

config CPU_CK805F
     bool "ck805f"
     help
       cpu of ck805f

config CPU_CK805EF
     bool "ck805ef"
     help
       cpu of ck805ef

config CPU_CK807
     bool "ck807"
     help
       cpu of ck807

config CPU_CK807F
     bool "ck807f"
     help
       cpu of ck807f

config CPU_CK810
     bool "ck810"
     help
       cpu of ck810

config CPU_CK810F
     bool "ck810f"
     help
       cpu of ck810f

config CPU_CK610E
     bool "ck610e"
     help
       cpu of ck610e

config CPU_CK610EF
     bool "ck610ef"
     help
       cpu of ck610ef

config CPU_C807
     bool "c807"
     help
       cpu of c807

config CPU_C807F
     bool "c807f"
     help
       cpu of c807f

config CPU_C807FV
     bool "c807fv"
     help
       cpu of c807fv

config CPU_R807
     bool "r807"
     help
       cpu of r807

config CPU_R807F
     bool "r807f"
     help
       cpu of r807f

config CPU_C810
     bool "c810"
     help
       cpu of c810

config CPU_C810T
     bool "c810t"
     select SYSTEM_SECURE
     help
       cpu of c810t

config CPU_C810V
     bool "c810v"
     help
       cpu of c810v

config CPU_C810TV
     bool "c810tv"
     select SYSTEM_SECURE
     help
       cpu of c810tv

endchoice

choice
     prompt "cpu options"
     default CPU_RV32EMC
     depends on ARCH_RV32
     help
         select the cpu

config CPU_RV32EMC
    bool "rv32emc"
    help
       cpu of rv32emc

config CPU_RV32EC
    bool "rv32ec"
    help
       cpu of rv32ec

config CPU_RV32I
    bool "rv32i"
    help
       cpu of rv32i

config CPU_RV32IAC
    bool "RV32iac"
    help
       cpu of rv32iac

config CPU_RV32IM
    bool "rv32im"
    help
       cpu of rv32im

config CPU_RV32IMAC
    bool "rv32imac"
    help
       cpu of rv32imac

config CPU_RV32IMAFC
    bool "rv32imafc"
    help
       cpu of rv32imafc

config CPU_E902
    bool "e902"
    help
       cpu of e902

config CPU_E902M
    bool "e902m"
    help
       cpu of e902m

config CPU_E906
    bool "e906"
    help
       cpu of e906

config CPU_E906F
    bool "e906f"
    help
       cpu of e906f

config CPU_E906FD
    bool "e906fd"
    help
       cpu of e906fd


endchoice

choice
     prompt "cpu options"
     default CPU_RV64IMAC
     depends on ARCH_RV64
     help
         select the cpu

config CPU_C906
     bool "c906"
     help
        cpu of c906

config CPU_C910
     bool "c910"
     help
       cpu of c910

config CPU_RV64IMAC
     bool "rv64imac"
     help
        cpu of rv64imac

config CPU_RV64IMACXCKI
     bool "rv64imacxcki"
     help
        cpu of rv32imacxcki

config CPU_RV64IMAFDC
     bool "rv64imafdc"
     help
        cpu of rv32imafdc

config CPU_RV64IMAFDCXCKI
     bool "rv64imafdcxcki"
     help
        cpu of rv32imafdcxcki

endchoice

choice
     prompt "cpu options"
     default CPU_CM0
     depends on ARCH_ARM
     help
         select the cpu

config CPU_CM0
     bool "cortex-m0"
     help
        cpu of cortex-m0

endchoice

choice
     prompt "coretim options"
     default CSKY_CORETIM
     help
         select the coretim type

config CSKY_CORETIM
    bool "csky coretim"
    help
       coretim of csky

config RV32_CORETIM
    bool "rv32"
    help
       coretim of rv32

endchoice

config SYSTEM_SECURE
    bool "security system"
    help
      select the security system

config XIP
    bool "xip"
    help
      select the run in flash

config MMU
    bool "mmu"
    help
      select the run in mmu
```

## csi-rtos/csi/csi_kernel/Kconfig
```kconfig
menu "Rtos kernel options"

choice
    prompt "kernel type selection"
    default KERNEL_NONE
    help
      select the os
config KERNEL_NONE
     bool "no rtos"
     help
       no rtos
config KERNEL_FREERTOS
     bool "freeRTOS"
     help
       os of freeRTOS
config KERNEL_UCOS
     bool "ucos-iii"
     help
       os of ucos-iii
config KERNEL_RHINO
     bool "rhino"
     help
       os of rhino
endchoice


endmenu


menu "OS support features"
config HAVE_VIC
     bool "interrupt nesting controller(VIC/CLIC)"
     default y
     depends on (!CPU_CK810 && !CPU_CK807 && !CPU_CK610E && !CPU_CK610EF)
     help
       interrupt nesting and tspend

config SUPPORT_TSPEND
     bool "support tspend"
     depends on (HAVE_VIC && !SYSTEM_SECURE || HAVE_VIC && ARCH_RV32)
     default y

config SEPARATE_IRQ_SP
     bool "hardware separate interrupt stack pointer"
     depends on SUPPORT_TSPEND
     default y
config ARCH_INTERRUPTSTACK
     int "stack for intrrupt"
     default 4096
config OS_TRACE
     bool "os trace"
     default n

endmenu

menu "Kernel memory management"
config MM_DETECT_ERROR
     bool "nuttx memory detect"
     default n

#config MM_KERNEL_HEAPSIZE
#     int "heapsize for kernel memory management"
#     default 32768
endmenu
```

## csi-rtos/csi/drivers/Kconfig
```kconfig
menu "csi drivers options"

config PMIC_DA9063_V1
    bool "pmic da9063 v1"
    default n
    help
      select the da9063 v1

config PMIC_DA9121_V1
      bool "pmic da9121 v1"
      default n
      help
        select the da9121 v1

config PMIC_SLG51000_V1
        bool "pmic slg51000 v1"
        default n
        help
          select the slg51000 v1

config PMIC_RICOH567_V0
          bool "pmic ricoh567 v0"
          default n
          help
            select the ricoh567 v0

config PMIC_RICOH567_V1
            bool "pmic ricoh567 v1"
            default n
            help
              select the ricoh567 v1

config PMIC_APTF110_V1
              bool "pmic aptf110 v1"
              default n
              help
                select the aptf110 v1

endmenu
```

## csi-rtos/csi/libs/Kconfig
```kconfig
menu "Debug options"

config SYSLOG_COLORFUL
	bool "Colorful syslog"
	default n
	help
	  syslog will be colorful.
	  If you use simple tools to debug, do not select it.

config SIMPLE_PRINTF
   bool "use simple printf"
   default n
   help
     simple printf is minimum code size, support less format

choice
     prompt "System log level"
     default SYSLOG_LEVEL_NONE
     help
       Set the global system log level.
       And each module can also set its own log level.

config SYSLOG_LEVEL_NONE
     bool "None"
     help
       Close any syslog

config SYSLOG_LEVEL_ERROR
     bool "Error"
     help
       Only error syslog shows

config SYSLOG_LEVEL_WARN
     bool "Error/Warn"
     help
       error/warning syslog shows

config SYSLOG_LEVEL_INFO
     bool "Error/Warn/Info"
     help
       error/warning/info syslog shows

config SYSLOG_LEVEL_DEBUG
     bool "Error/Warn/Info/Debug"
     help
       error/warning/info/debug syslog shows

endchoice

endmenu
```

## csi-rtos/modules/Kconfig
```kconfig
menu "Modules option"

config CMSIS_ADAPTER
    bool "cmsis adapter"
    default n
    help
      select cmsis adapter
if CMSIS_ADAPTER
endif

config MBED_ADAPTER
    bool "mbed os adapter"
    depends on CMSIS_RTOS
    default n
    help
      select mbed os adapter

config OS_COMM
    bool "os comm"
    default n
    help
      select os comm

config FATFS
     bool "fatfs"
     default n
     help
       select support fatfs module

config NEWLIB_WRAP
     bool "newlib wrap"
     default n
     help
       select newlib and newlib wrap

config FAAD
     bool "faad"
     default n
     help
       select faad

config OPUS
     bool "opus"
     default n
     help
       select opus

endmenu
```

## csi-rtos/solutions/Kconfig
```kconfig
menu "Projects options"

choice
     prompt "select examples"
     default FM_AON_LOW_POWER
     help
      select the solutions

config FM_AON_LOW_POWER
    bool "Light FM Aon low power"
    help
      select the Aon low power solution
if FM_AON_LOW_POWER
source "solutions/fm_aon_low_power/Kconfig"
endif

endchoice
endmenu
```

## csi-rtos/solutions/fm_aon_low_power/Kconfig
```kconfig
choice 
    prompt "select ddr type"
    default DDR_LP4X_3733_SINGLERANK
    help
        select the ddr type

config DDR_LP4X_4266_DUALRANK
        bool "LPDDR4X 4266 dualrank configuration"
        help
          Enabling this will support lpddr4x 4266 dualrank configuration.
config DDR_LP4X_4266_SINGLERANK
        bool "LPDDR4X 4266 singlerank configuration"
        help
          Enabling this will support lpddr4x 4266 singlerank configuration.
config DDR_LP4X_3733_DUALRANK
        bool "LPDDR4X 3733 dualrank configuration"
        help
          Enabling this will support lpddr4x 3733 dualrank configuration.
config DDR_LP4X_3733_SINGLERANK
        bool "LPDDR4X 3733 singlerank configuration"
        help
          Enabling this will support lpddr4x 3733 singlerank configuration.
config DDR_LP4X_3200_DUALRANK
        bool "LPDDR4X 3200 dualrank configuration"
        help
          Enabling this will support lpddr4x 3200 dualrank configuration.
config DDR_LP4X_3200_SINGLERANK
        bool "LPDDR4X 3200 singlerank configuration"
        help
          Enabling this will support lpddr4x 3200 singlerank configuration.
config DDR_LP4X_2133_DUALRANK
        bool "LPDDR4X 2133 dualrank configuration"
        help
          Enabling this will support lpddr4x 2133 dualrank configuration.
config DDR_LP4X_2133_SINGLERANK
        bool "LPDDR4X 2133 singlerank configuration"
        help
          Enabling this will support lpddr4x 2133 singlerank configuration.
config DDR_LP4_4266_DUALRANK
        bool "LPDDR4 4266 dualrank configuration"
        help
          Enabling this will support lpddr4 4266 dualrank configuration.
config DDR_LP4_4266_SINGLERANK
        bool "LPDDR4 4266 singlerank configuration"
        help
          Enabling this will support lpddr4 4266 singlerank configuration.
config DDR_LP4_3733_DUALRANK
        bool "LPDDR4 3733 dualrank configuration"
        help
          Enabling this will support lpddr4 3733 dualrank configuration.
config DDR_LP4_3733_SINGLERANK
        bool "LPDDR4 3733 singlerank configuration"
        help
          Enabling this will support lpddr4 3733 singlerank configuration.
config DDR_LP4_3200_DUALRANK
        bool "LPDDR4 3200 dualrank configuration"
        help
          Enabling this will support lpddr4 3200 dualrank configuration.
config DDR_LP4_3200_SINGLERANK
        bool "LPDDR4 3200 singlerank configuration"
        help
          Enabling this will support lpddr4 3200 singlerank configuration.
config DDR_LP4_2133_DUALRANK
        bool "LPDDR4 2133 dualrank configuration"
        help
          Enabling this will support lpddr4 2133 dualrank configuration.
config DDR_LP4_2133_SINGLERANK
        bool "LPDDR4 2133 singlerank configuration"
        help
          Enabling this will support lpddr4 2133 singlerank configuration.

config DDR_H32_MODE
        bool "LPDDR4/4X 32bit mode configuration"
        help
          Enabling this will support ddr 32bit mode configuration.
endchoice

config LPDDR4X
        def_bool y if DDR_LP4X_4266_DUALRANK || DDR_LP4X_4266_SINGLERANK || DDR_LP4X_3733_DUALRANK || DDR_LP4X_3733_SINGLERANK \
                        || DDR_LP4X_3200_DUALRANK || DDR_LP4X_3200_SINGLERANK || DDR_LP4X_2133_DUALRANK || DDR_LP4X_2133_SINGLERANK
config LPDDR4
        def_bool y if !LPDDR4X && (DDR_LP4_4266_DUALRANK || DDR_LP4_4266_SINGLERANK || DDR_LP4_3733_DUALRANK || DDR_LP4_3733_SINGLERANK \
                        || DDR_LP4_3200_DUALRANK || DDR_LP4_3200_SINGLERANK || DDR_LP4_2133_DUALRANK || DDR_LP4_2133_SINGLERANK)

config LPDDR
        def_bool y if LPDDR4X || LPDDR4

config DDR_4266
        def_bool y if DDR_LP4X_4266_DUALRANK || DDR_LP4X_4266_SINGLERANK || DDR_LP4_4266_DUALRANK || DDR_LP4_4266_SINGLERANK
config DDR_3733
        def_bool y if DDR_LP4X_3733_DUALRANK || DDR_LP4X_3733_SINGLERANK || DDR_LP4_3733_DUALRANK || DDR_LP4_3733_SINGLERANK
config DDR_3200
        def_bool y if DDR_LP4X_3200_DUALRANK || DDR_LP4X_3200_SINGLERANK || DDR_LP4_3200_DUALRANK || DDR_LP4_3200_SINGLERANK
config DDR_2133
        def_bool y if DDR_LP4X_2133_DUALRANK || DDR_LP4X_2133_SINGLERANK || DDR_LP4_2133_DUALRANK || DDR_LP4_2133_SINGLERANK

config FW_MSG_L3
        def_bool n
config FW_MSG_L2
        def_bool y if !FW_MSG_L3
config FW_MSG_L1
        def_bool y if !FW_MSG_L3 && !FW_MSG_L2
config FW_MSG_TRAIN_1D
        def_bool y if FW_MSG_L2
config DDR_MSG
	def_bool y if FW_MSG_L1 || FW_MSG_L2 || FW_MSG_L3
config DDR_HARD_2D
	def_bool y

config DDR_CHBIT_256B
        def_bool y if !DDR_H32_MODE

config DDR_DBI_OFF
        def_bool n

config LPDDR_EYE
        def_bool n
config LPDDR_TXEYE
        def_bool n if LPDDR_EYE
config SIMPLE_CONSOLE
        bool "simple aon monitor"
        default n
        help
        select simple aon monitor
```

## csi-rtos/validations/Kconfig
```kconfig
choice
        prompt "select"
        default BUILD_VAL_DRIVER
        help
          select the test module

config BUILD_VAL_DRIVER
       bool "driver validation"
       help
          driver validation
if BUILD_VAL_DRIVER
source "validations/driver/Kconfig"
endif

config BUILD_VAL_CORE
       bool "core validation"
       help
          core validation
if BUILD_VAL_CORE
source "validations/core/Kconfig"
endif


config BUILD_VAL_KERNEL
       bool "kernel validation"
       help
          kernel validation
if BUILD_VAL_KERNEL
source "validations/kernel/Kconfig"
endif

endchoice
```
