## csi-rtos/validations/kernel/sem/Kconfig
```kconfig
choice
       prompt "select"
       depends on BUILD_VAL_SEM
       default BUILD_VAL_SEM01
       help
         select the test module

config BUILD_VAL_SEM01
       bool "build validation sem01"
       depends on BUILD_VAL_SEM
       help
         select the sem test

config BUILD_VAL_SEM02
       bool "build validation sem02"
       depends on BUILD_VAL_SEM
       help
         select the sem test


endchoice
```

## csi-rtos/validations/kernel/soft_timer/Kconfig
```kconfig
choice
       prompt "select"
       depends on BUILD_VAL_SOFT_TIMER
       default BUILD_VAL_SOFT_TIMER01
       help
         select the test module

config BUILD_VAL_SOFT_TIMER01
       bool "build validation soft_timer01"
       depends on BUILD_VAL_SOFT_TIMER
       help
         select the soft timer test

endchoice
```

## csi-rtos/validations/kernel/task/Kconfig
```kconfig
choice
       prompt "select"
       depends on BUILD_VAL_TASK
       default BUILD_VAL_TASK01
       help
         select the test module

config BUILD_VAL_TASK01
       bool "build validation task01"
       depends on BUILD_VAL_TASK
       help
         select the task test

config BUILD_VAL_TASK02
       bool "build validation task02"
       depends on BUILD_VAL_TASK
       help
         select the task test
endchoice
```
