## csi-rtos/validations/driver/eth/Kconfig
```kconfig
choice
       prompt "select"
       depends on BUILD_VAL_ETH
       default BUILD_VAL_ETH01
       help
         select the test module

config BUILD_VAL_ETH01
       bool "build validation eth01"
       depends on BUILD_VAL_ETH
       help
         select the eth driver validation

endchoice
```

## csi-rtos/validations/driver/gpio/Kconfig
```kconfig
choice
       prompt "select"
       depends on BUILD_VAL_GPIO
       default BUILD_VAL_GPIO01
       help
         select the test module

config BUILD_VAL_GPIO01
       bool "build validation gpio01"
       depends on BUILD_VAL_GPIO
       help
         select the gpio driver validation

config BUILD_VAL_GPIO02
       bool "build validation gpio02"
       depends on BUILD_VAL_GPIO
       help
         select the gpio driver validation
endchoice
```

## csi-rtos/validations/driver/i2s/Kconfig
```kconfig
choice
       prompt "select"
       depends on BUILD_VAL_I2S
       default BUILD_VAL_I2S01
       help
         select the test module

config BUILD_VAL_I2S01
       bool "build validation i2s01"
       depends on BUILD_VAL_I2S
       help
         select the i2s driver validation


config BUILD_VAL_I2S02
       bool "build validation i2s02"
       depends on BUILD_VAL_I2S
       help
         select the i2s driver validation
endchoice
```

## csi-rtos/validations/driver/iic/Kconfig
```kconfig
choice
       prompt "select"
       depends on BUILD_VAL_IIC
       default BUILD_VAL_IIC01
       help
         select the test module

config BUILD_VAL_IIC01
       bool "build validation iic01"
       depends on BUILD_VAL_IIC
       help
         select the iic driver validation

config BUILD_VAL_IIC02
       bool "build validation iic02"
       depends on BUILD_VAL_IIC
       help
         select the iic driver validation

config BUILD_VAL_IIC_SPEED
       bool "build validation iic_speed"
       depends on BUILD_VAL_IIC
       help
         select the iic driver validation
endchoice
```

## csi-rtos/validations/driver/pwm/Kconfig
```kconfig
choice
       prompt "select"
       depends on BUILD_VAL_PWM
       default BUILD_VAL_PWM01
       help
         select the test module

config BUILD_VAL_PWM01
       bool "build validation pwm01"
       depends on BUILD_VAL_PWM
       help
         select the pwm driver validation

config BUILD_VAL_PWM02
       bool "build validation pwm02"
       depends on BUILD_VAL_PWM
       help
         select the pwm driver validation
endchoice
```

## csi-rtos/validations/driver/rsa/Kconfig
```kconfig
choice
       prompt "select"
       depends on BUILD_VAL_RSA
       default BUILD_VAL_RSA01
       help
         select the test module

config BUILD_VAL_RSA01
       bool "build validation rsa01"
       depends on BUILD_VAL_RSA
       help
         select the rsa driver validation

config BUILD_VAL_RSA02
       bool "build validation rsa02"
       depends on BUILD_VAL_RSA
       help
         select the rsa driver validation
endchoice
```

## csi-rtos/validations/driver/rtc/Kconfig
```kconfig
choice
       prompt "select"
       depends on BUILD_VAL_RTC
       default BUILD_VAL_RTC01
       help
         select the test module

config BUILD_VAL_RTC01
       bool "build validation rtc01"
       depends on BUILD_VAL_RTC
       help
         select the rtc driver validation

config BUILD_VAL_RTC02
       bool "build validation rtc02"
       depends on BUILD_VAL_RTC
       help
         select the rtc driver validation
endchoice
```

## csi-rtos/validations/driver/sha/Kconfig
```kconfig
choice
       prompt "select"
       depends on BUILD_VAL_SHA
       default BUILD_VAL_SHA01
       help
         select the test module

config BUILD_VAL_SHA01
       bool "build validation sha01"
       depends on BUILD_VAL_SHA
       help
         select the sha driver validation

config BUILD_VAL_SHA02
       bool "build validation sha02"
       depends on BUILD_VAL_SHA
       help
         select the sha driver validation
endchoice
```

## csi-rtos/validations/driver/spi/Kconfig
```kconfig
choice
       prompt "select"
       depends on BUILD_VAL_SPI
       default BUILD_VAL_SPI01
       help
         select the test module

config BUILD_VAL_SPI01
       bool "build validation spi01"
       depends on BUILD_VAL_SPI
       help
         select the spi driver validation

config BUILD_VAL_SPI02
       bool "build validation spi02"
       depends on BUILD_VAL_SPI
       help
         select the spi driver validation

config BUILD_VAL_SPI_SPEED
       bool "build validation spi_speed"
       depends on BUILD_VAL_SPI
       help
         select the spi driver validation
endchoice
```

## csi-rtos/validations/driver/spiflash/Kconfig
```kconfig
choice
       prompt "select"
       depends on BUILD_VAL_SPIFLASH
       default BUILD_VAL_SPIFLASH01
       help
         select the test module

config BUILD_VAL_SPIFLASH01
       bool "build validation spiflash01"
       depends on BUILD_VAL_SPIFLASH
       help
         select the spiflash driver validation

config BUILD_VAL_SPIFLASH02
       bool "build validation spiflash02"
       depends on BUILD_VAL_SPIFLASH
       help
         select the spiflash driver validation
endchoice
```

## csi-rtos/validations/driver/spu_iic/Kconfig
```kconfig
choice
       prompt "select"
       depends on BUILD_VAL_SPU_IIC
       default BUILD_VAL_SPU_IIC01
       help
         select the test module

config BUILD_VAL_SPU_IIC01
       bool "build validation spu_iic01"
       depends on BUILD_VAL_SPU_IIC
       help
         select the spu_iic driver validation

endchoice
```

## csi-rtos/validations/driver/spu_spi/Kconfig
```kconfig
choice
       prompt "select"
       depends on BUILD_VAL_SPU_SPI
       default BUILD_VAL_SPU_SPI01
       help
         select the test module

config BUILD_VAL_SPU_SPI01
       bool "build validation spu_spi01"
       depends on BUILD_VAL_SPU_SPI
       help
         select the spu_spi driver validation

endchoice
```

## csi-rtos/validations/driver/spu_usart/Kconfig
```kconfig
choice
       prompt "select"
       depends on BUILD_VAL_SPU_USART
       default BUILD_VAL_SPU_USART01
       help
         select the test module

config BUILD_VAL_SPU_USART01
       bool "build validation spu_usart01"
       depends on BUILD_VAL_SPU_USART
       help
         select the spu_usart driver validation

endchoice
```

## csi-rtos/validations/driver/timer/Kconfig
```kconfig
choice
       prompt "select"
       depends on BUILD_VAL_TIMER
       default BUILD_VAL_TIMER01
       help
         select the test module

config BUILD_VAL_TIMER01
       bool "build validation timer01"
       depends on BUILD_VAL_TIMER
       help
         select the timer driver validation

config BUILD_VAL_TIMER02
       bool "build validation timer02"
       depends on BUILD_VAL_TIMER
       help
         select the timer driver validation
endchoice
```

## csi-rtos/validations/driver/trng/Kconfig
```kconfig
choice
       prompt "select"
       depends on BUILD_VAL_TRNG
       default BUILD_VAL_TRNG01
       help
         select the test module

config BUILD_VAL_TRNG01
       bool "build validation trng01"
       depends on BUILD_VAL_TRNG
       help
         select the trng driver validation

config BUILD_VAL_TRNG02
       bool "build validation trng02"
       depends on BUILD_VAL_TRNG
       help
         select the trng driver validation
endchoice
```

## csi-rtos/validations/driver/usart/Kconfig
```kconfig
choice
       prompt "select"
       depends on BUILD_VAL_USART
       default BUILD_VAL_USART01
       help
         select the test module

config BUILD_VAL_USART01
       bool "build validation usart01"
       depends on BUILD_VAL_USART
       help
         select the usart driver validation

config BUILD_VAL_USART02
       bool "build validation usart02"
       depends on BUILD_VAL_USART
       help
         select the usart driver validation

config BUILD_VAL_USART_SPEED
       bool "build validation usart_speed"
       depends on BUILD_VAL_USART
       help
         select the usart driver validation
endchoice
```

## csi-rtos/validations/driver/usi_iic/Kconfig
```kconfig
choice
       prompt "select"
       depends on BUILD_VAL_USI_IIC
       default BUILD_VAL_USI_IIC01
       help
         select the test module

config BUILD_VAL_USI_IIC01
       bool "build validation usi_iic01"
       depends on BUILD_VAL_USI_IIC
       help
         select the usi_iic driver validation

endchoice
```

## csi-rtos/validations/driver/usi_spi/Kconfig
```kconfig
choice
       prompt "select"
       depends on BUILD_VAL_USI_SPI
       default BUILD_VAL_USI_SPI01
       help
         select the test module

config BUILD_VAL_USI_SPI01
       bool "build validation usi_spi01"
       depends on BUILD_VAL_USI_SPI
       help
         select the usi_spi driver validation

endchoice
```

## csi-rtos/validations/driver/usi_usart/Kconfig
```kconfig
choice
       prompt "select"
       depends on BUILD_VAL_USI_USART
       default BUILD_VAL_USI_USART01
       help
         select the test module

config BUILD_VAL_USI_USART01
       bool "build validation usi_usart01"
       depends on BUILD_VAL_USI_USART
       help
         select the usi_usart driver validation

endchoice
```

## csi-rtos/validations/driver/wdt/Kconfig
```kconfig
choice
       prompt "select"
       depends on BUILD_VAL_WDT
       default BUILD_VAL_WDT01
       help
         select the test module

config BUILD_VAL_WDT01
       bool "build validation wdt01"
       depends on BUILD_VAL_WDT
       help
         select the wdt driver validation

config BUILD_VAL_WDT02
       bool "build validation wdt02"
       depends on BUILD_VAL_WDT
       help
         select the wdt driver validation
endchoice
```

## csi-rtos/validations/kernel/Kconfig
```kconfig
#menu "choose kernel cases"

choice
       prompt "select"
       help
         select the kernel validation

config BUILD_VAL_TASK
       bool "test kernel task"
       help
          select the kernel task test

if BUILD_VAL_TASK
source "validations/kernel/task/Kconfig"
endif

config BUILD_VAL_SEM
       bool "test kernel semaphore"
       help
          select the kernel semaphore test

if BUILD_VAL_SEM
source "validations/kernel/sem/Kconfig"
endif

config BUILD_VAL_MSGQ
       bool "test kernel message queue"
       help
          select the kernel message queue test

if BUILD_VAL_MSGQ
source "validations/kernel/msgq/Kconfig"
endif

config BUILD_VAL_MUTEX
       bool "test kernel mutex"
       help
          select the kernel mutex test

if BUILD_VAL_MUTEX
source "validations/kernel/mutex/Kconfig"
endif

config BUILD_VAL_EVENT
       bool "test kernel event"
       help
          select the kernel event test

if BUILD_VAL_EVENT
source "validations/kernel/event/Kconfig"
endif

config BUILD_VAL_SOFT_TIMER
       bool "test kernel soft timer"
       help
          select the kernel soft timer test

if BUILD_VAL_SOFT_TIMER
source "validations/kernel/soft_timer/Kconfig"
endif

config BUILD_VAL_MEMPOOL
       bool "test kernel memory pool"
       depends on !KERNEL_FREERTOS
       help
          select the kernel memory pool test

if BUILD_VAL_MEMPOOL
source "validations/kernel/mempool/Kconfig"
endif

endchoice

#endmenu
```

## csi-rtos/validations/kernel/event/Kconfig
```kconfig
choice
       prompt "select"
       depends on BUILD_VAL_EVENT
       default BUILD_VAL_EVENT01
       help
         select the test module

config BUILD_VAL_EVENT01
       bool "build validation event01"
       depends on BUILD_VAL_EVENT
       help
         select the event test

endchoice
```

## csi-rtos/validations/kernel/mempool/Kconfig
```kconfig
choice
       prompt "select"
       depends on BUILD_VAL_MEMPOOL
       default BUILD_VAL_MEMPOOL01
       help
         select the test module

config BUILD_VAL_MEMPOOL01
       bool "build validation mempool01"
       depends on BUILD_VAL_MEMPOOL
       help
         select the mempool test

config BUILD_VAL_MEMPOOL02
       bool "build validation mempool02"
	   depends on BUILD_VAL_MEMPOOL
	   help
	     select the mempool test


endchoice
```

## csi-rtos/validations/kernel/msgq/Kconfig
```kconfig
choice
       prompt "select"
       depends on BUILD_VAL_MSGQ
       default BUILD_VAL_MSGQ01
       help
         select the test module

config BUILD_VAL_MSGQ01
       bool "build validation msgq01"
       depends on BUILD_VAL_MSGQ
       help
         select the msgq test

config BUILD_VAL_MSGQ02
       bool "build validation msgq02"
       depends on BUILD_VAL_MSGQ
	   help
       select the msgq test


endchoice
```

## csi-rtos/validations/kernel/mutex/Kconfig
```kconfig
choice
       prompt "select"
       depends on BUILD_VAL_MUTEX
       default BUILD_VAL_MUTEX01
       help
         select the test module

config BUILD_VAL_MUTEX01
       bool "build validation mutex01"
       depends on BUILD_VAL_MUTEX
       help
         select the mutex test

endchoice
```
